BO_ 0x280 Motor_Data: 8 Vector__XXX

    SG_ estadoPedal  : 0|8@1+ (1,0) [1|9] "Estado do Pedal" ECU
    SG_ rpm         : 3|16@1+ (0.25,0) [0|16383.75] "RPM" ECU
    SG_ bomba_comb    : 5|8@1+ (0.4,0) [0|100] "%" ECU
    SG_ bobina_inj : 6|8@1+ (1,0) [0|255] "%" ECU
    SG_ acelerador  : 40|8@1+ (1,0) [0|250] "Acelerador" ECU
    SG_ admissaoAr  : 80|8@1+ (1,0) [0|255] "Admissão de Ar" ECU

BO_416 fereios:
0x1A0: b1 - Brake pedal (bit 3).

BO_0x520 eletrica: 8bytes

    byte 0 (?) >>> byte 1 (?) mantem valores cíclicos e se acompanham
    byte 2 (ignição ligada e desligada (2|0) respectivamente)
    byte 3 (tensão da bateria / (0.0588235,0) [0|255] "V")
    byte 4(?) >>> byte 5(?) >>> byte 6(?) >>> byte 7(?) mantem valores contantes(Hodmetro?)

BO_0x1A0: (?)
    byte 0(?) >> byte 2(?) >> byte 3(?) >> byte 4(?) >> byte 6(?) estão todos com valor fixo de 0 e não alteram
    byte 1 (?) altera seu estado entre [0|5] quando a chave esta ligada e desligada respectivamente
    byte 7 (?) alteração cíclica de [0|D]
